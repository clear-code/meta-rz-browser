## conf/layer.conf
```bitbake
# We have a conf and classes directory, add to BBPATH
BBPATH .= ":${LAYERDIR}"

# We have recipes-* directories, add to BBFILES
BBFILES += " \
    ${LAYERDIR}/recipes-*/*/*.bb \
    ${LAYERDIR}/recipes-*/*/*.bbappend \
"

BBFILE_COLLECTIONS += "browser-hwdecode"
BBFILE_PATTERN_browser-hwdecode = "^${LAYERDIR}/"
BBFILE_PRIORITY_browser-hwdecode = "6"
BBFILES_DYNAMIC += " \
    meta-rz-bsp:${LAYERDIR}/dynamic-layers/meta-rz-bsp/recipes-*/*/*.bb \
    meta-rz-bsp:${LAYERDIR}/dynamic-layers/meta-rz-bsp/recipes-*/*/*.bbappend \
    meta-rz-graphics:${LAYERDIR}/dynamic-layers/meta-rz-graphics/recipes-*/*/*.bb \
    meta-rz-graphics:${LAYERDIR}/dynamic-layers/meta-rz-graphics/recipes-*/*/*.bbappend \
    meta-rz-codecs:${LAYERDIR}/dynamic-layers/meta-rz-codecs/recipes-*/*/*.bb \
    meta-rz-codecs:${LAYERDIR}/dynamic-layers/meta-rz-codecs/recipes-*/*/*.bbappend \
"

LAYERSERIES_COMPAT_browser-hwdecode = "scarthgap"

LAYERDEPENDS_browser-hwdecode = "chromium-browser-layer"
```
